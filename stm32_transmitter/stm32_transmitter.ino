#include <SPI.h>
#include <RF24.h>
#include <RF24Network.h>
#include <EEPROM.h>
#include <U8g2lib.h>
#include <Wire.h>

// UI Images
static const unsigned char image_network_bits[] U8X8_PROGMEM = { 0x00, 0x70, 0x00, 0x50, 0x00, 0x50, 0x00, 0x50, 0x00, 0x57, 0x00, 0x55, 0x00, 0x55, 0x00, 0x55, 0x70, 0x55, 0x50, 0x55, 0x50, 0x55, 0x50, 0x55, 0x57, 0x55, 0x55, 0x55, 0x77, 0x77, 0x00, 0x00 };
static const unsigned char image_network_not_connected_bits[] U8X8_PROGMEM = { 0x41, 0x70, 0x22, 0x50, 0x14, 0x50, 0x08, 0x50, 0x14, 0x57, 0x22, 0x55, 0x41, 0x55, 0x00, 0x55, 0x70, 0x55, 0x50, 0x55, 0x50, 0x55, 0x50, 0x55, 0x57, 0x55, 0x55, 0x55, 0x77, 0x77, 0x00, 0x00 };
static const unsigned char image_battery_empty_bits[] U8X8_PROGMEM = { 0x00, 0x00, 0x00, 0xfe, 0xff, 0x0f, 0x01, 0x00, 0x10, 0x01, 0x00, 0x10, 0x01,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 0x00, 0x00 };
static const unsigned char image_power_text_bits[] U8X8_PROGMEM = { 0xc7, 0x44, 0x77, 0x29, 0x45, 0x91, 0x27, 0x55, 0x73, 0x21, 0x55, 0x51, 0xc1, 0x28, 0x97 };
static const unsigned char image_emc_logo2_bits[] U8X8_PROGMEM = { 0x00, 0x00, 0x00, 0x00, 0x00, 0x00, 0x00, 0x00, 0x00, 0x00, 0x00, 0x00, 0x00,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 0x00, 0x00 };
static const unsigned char image_Warning_bits[] U8X8_PROGMEM = {0x00,0xc0,0x00,0x00,0x00,0xe0,0x01,0x00,0x00,0xf0,0x03,0x00,0x00,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0xff,0x1f};

// 'icon_autocalibrate', 16x16px
const unsigned char epd_bitmap_icon_autocalibrate [] PROGMEM = {
	0xe0, 0x07, 0x38, 0x1c, 0x0c, 0x30, 0x06, 0x60, 0x02, 0x40, 0x83, 0xc1, 0x41, 0x82, 0x41, 0x82, 
	0x41, 0x82, 0xc1, 0x83, 0x43, 0x42, 0x42, 0x42, 0x06, 0x60, 0x0c, 0x30, 0x38, 0x1c, 0xe0, 0x07
};
// 'icon_manualsetup', 16x16px
const unsigned char epd_bitmap_icon_manualsetup [] PROGMEM = {
	0x00, 0x00, 0x00, 0x00, 0x00, 0x00, 0x60, 0x00, 0xfe, 0x7f, 0x60, 0x00, 0x00, 0x00, 0x00, 0x06, 
	0xfe, 0x7f, 0x00, 0x06, 0x00, 0x00, 0x0c, 0x00, 0xfe, 0x7f, 0x0c, 0x00, 0x00, 0x00, 0x00, 0x00
};
// 'icon_swandbtntest', 16x16px
const unsigned char epd_bitmap_icon_swandbtntest [] PROGMEM = {
	0x00, 0x00, 0x00, 0x00, 0xc0, 0x03, 0xe0, 0x07, 0xe0, 0x07, 0xe0, 0x07, 0xc0, 0x03, 0x80, 0x01, 
	0x80, 0x01, 0x80, 0x01, 0xf8, 0x1f, 0xfc, 0x3f, 0xfc, 0x3f, 0xfc, 0x3f, 0xf8, 0x1f, 0x00, 0x00
};

// Array of all bitmaps for convenience. (Total bytes used to store images in PROGMEM = 144)
const int epd_bitmap_allArray_LEN = 3;
const unsigned char* bitmap_icons[epd_bitmap_allArray_LEN] = {
	epd_bitmap_icon_autocalibrate,
	epd_bitmap_icon_manualsetup,
	epd_bitmap_icon_swandbtntest
};


// 'scrollbar_background', 8x64px
const unsigned char bitmap_scrollbar_background [] PROGMEM = {
  0x00, 0x40, 0x00, 0x40, 0x00, 0x40, 0x00, 0x40, 0x00, 0x40, 0x00, 0x40, 
  0x00, 0x40, 0x00, 0x40, 0x00, 0x40, 0x00, 0x40, 0x00, 0x40, 0x00, 0x40, 
  0x00, 0x40, 0x00, 0x40, 0x00, 0x40, 0x00, 0x40, 0x00, 0x40, 0x00, 0x40, 
  0x00, 0x40, 0x00, 0x40, 0x00, 0x40, 0x00, 0x40, 0x00, 0x40, 0x00, 0x40, 
  0x00, 0x40, 0x00, 0x40, 0x00, 0x40, 0x00, 0x40, 0x00, 0x40, 0x00, 0x40, 
  0x00, 0x40, 0x00, 0x00, };


// 'item_sel_outline', 128x21px
const unsigned char bitmap_item_sel_outline [] PROGMEM = {
  0xF8, 0xFF, 0xFF, 0xFF, 0xFF, 0xFF, 0xFF, 0xFF, 0xFF, 0xFF, 0xFF, 0xFF, 
  0xFF, 0xFF, 0xFF, 0x03, 0x04, 0x00, 0x00, 0x00, 0x00, 0x00, 0x00, 0x00, 
  0x00, 0x00, 0x00, 0x00, 0x00, 0x00, 0x00, 0x04, 0x02, 0x00, 0x00, 0x00, 
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  0xFF, 0xFF, 0xFF, 0xFF, 0xFF, 0xFF, 0xFF, 0xFF, 0xFF, 0xFF, 0xFF, 0x03, 
  };

// 'popup_warning', 96x48px
const unsigned char epd_bitmap_popup_warning [] PROGMEM = {
	0xff, 0xff, 0xff, 0xff, 0xff, 0xff, 0xff, 0xff, 0xff, 0xff, 0xff, 0xff, 0x01, 0x00, 0x00, 0x00, 
	0x00, 0x00, 0x00, 0x00, 0x00, 0x00, 0x00, 0x80, 0x01, 0x00, 0x00, 0x00, 0x00, 0x00, 0x00, 0x00, 
	0x00, 0x00, 0x00, 0x80, 0x01, 0x00, 0x00, 0x00, 0x00, 0x00, 0x00, 0x00, 0x00, 0x00, 0x00, 0x80, 
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	0x00, 0x00, 0x00, 0x80, 0xff, 0xff, 0xff, 0xff, 0xff, 0xff, 0xff, 0xff, 0xff, 0xff, 0xff, 0xff
};


const int NUM_ITEMS = 3; // number of items in the list and also the number of screenshots and screenshots with QR codes (other screens)
const int MAX_ITEM_LENGTH = 20; // maximum characters for the item name

char menu_items [NUM_ITEMS] [MAX_ITEM_LENGTH] = {  // array with item names
  { "Auto Calibrate" }, 
  { "Manual Setup" }, 
  { "Sw and Btn Test" }
};

const int NUM_PARAMS = 12; // number of items in the list and also the number of screenshots and screenshots with QR codes (other screens)
const int MAX_NAME_LENGTH = 20; // maximum characters for the item name

char param_items [NUM_PARAMS] [MAX_NAME_LENGTH] = {  // array with item names
  { "centerX1" },
  { "centerY1" },
  { "minOffsetX1" },
  { "maxOffsetX1" },
  { "minOffsetY1" },
  { "maxOffsetY1" },
  { "centerX2" },
  { "centerY2" },
  { "minOffsetX2" },
  { "maxOffsetX2" },
  { "minOffsetY2" },
  { "maxOffsetY2" },

};


bool manualEdit = false;
bool saveChangesSelect = false;

// OLED Setup - SSD1306
U8G2_SSD1306_128X64_NONAME_F_HW_I2C u8g2(U8G2_R0, U8X8_PIN_NONE);
char joystickBuffer[5];
char buf[5];

// Pin Definitions
#define JOYR_X A0
#define JOYR_Y A1
#define JOYL_X A2
#define JOYL_Y A3
#define CE_PIN PA4
#define CSN_PIN PB0
#define MENU_BTN PB11
#define UP_BTN PB10
#define DOWN_BTN PA11
#define BACK_BTN PA12
#define ARMED_SWITCH PA15
#define LIGHT_SWITCH PB3
#define VOLTAGE_PIN PB1

// RF24 Setup
RF24 radio(CE_PIN, CSN_PIN);
RF24Network network(radio);
const uint16_t this_node = 01;
const uint16_t other_node = 00;

// Joystick Settings
const int deadZone = 20;
int16_t centerX1, centerY1, minOffsetX1, maxOffsetX1, minOffsetY1, maxOffsetY1;
int16_t centerX2, centerY2, minOffsetX2, maxOffsetX2, minOffsetY2, maxOffsetY2;

// EEPROM
#define EEPROM_ADDR 0

struct CalibrationData {
  int16_t centerX1, centerY1, minOffsetX1, maxOffsetX1, minOffsetY1, maxOffsetY1;
  int16_t centerX2, centerY2, minOffsetX2, maxOffsetX2, minOffsetY2, maxOffsetY2;
};

CalibrationData data;




struct JoystickPayload {
  int8_t joyRX;
  int8_t joyRY;
  int8_t joyLX;
  int8_t joyLY;

  uint8_t armingSwitch : 1;
  uint8_t lightSwitch : 1;
  uint8_t toggle3Switch1 : 2;
  uint8_t toggle3Switch2 : 2;
  uint8_t reserved : 2;
} __attribute__((__packed__));

JoystickPayload payload;


int16_t params_data_list[NUM_PARAMS];


// Timing
unsigned long lastSendTime = 0;
const unsigned long sendInterval = 20;  // 20ms (50Hz)

// Calibration State
// bool isCalibrating = false;
uint8_t calibrationStage = 0;
unsigned long calibrationStartTime = 0;
unsigned long prevTime = 0;

int notConnectedCount = 100;

bool armedSwitchState;
bool lightSwitchState;
// int calBtnState;

// Voltage divider resistors (in ohms)
const float R1 = 10000.0; // 10kΩ
const float R2 = 3300.0;  // 3.3kΩ

// ADC and voltage specs
const float vRef = 3.3;
const int adcMax = 1023;

// Battery voltage range
const float batteryMin = 6.0;  // 0%
const float batteryMax = 9.0;  // 100%

int batteryPercentage;
unsigned long batteryTime = 0;
const unsigned long batteryInterval = 1000;

bool confirmSelect = false;


bool showText = true;
unsigned long previousMillis = 0;
const unsigned long blinkInterval = 300; // milliseconds

// === DebouncedButton Class ===
class DebouncedButton {
  private:
    int buttonPin;
    int lastButtonState;
    int lastStableState;
    unsigned long lastDebounceTime;
    unsigned long debounceDelay;

  public:
    DebouncedButton(int pin, unsigned long delay = 50) {
      buttonPin = pin;
      debounceDelay = delay;
      pinMode(buttonPin, INPUT_PULLUP);
      lastButtonState = HIGH;
      lastStableState = HIGH;
      lastDebounceTime = 0;
    }

    bool isPressed() {
      int currentState = digitalRead(buttonPin);
      if (currentState != lastButtonState) {
        lastDebounceTime = millis();
        lastButtonState = currentState;
      }
      if ((millis() - lastDebounceTime) > debounceDelay) {
        if (currentState != lastStableState) {
          lastStableState = currentState;
          if (lastStableState == LOW) {
            return true;
          }
        }
      }
      return false;
    }
};

// === Instantiate button objects ===
DebouncedButton menuButton(MENU_BTN);
DebouncedButton upButton(UP_BTN);
DebouncedButton downButton(DOWN_BTN);
DebouncedButton backButton(BACK_BTN);


// bool inMenu = false;

enum Screen {
  HOME,
  MENU,
  AUTOCALIBRATE,
  MANUALSETUP,
  SWANDBTNTEST,
  AUTOCALIBRATE1,
  SAVECHANGES,
};

Screen currentScreen = Screen::HOME;

int item_selected = 0; // which item in the menu is selected

int item_sel_previous; // previous item - used in the menu screen to draw the item before the selected one
int item_sel_next; // next item - used in the menu screen to draw next item after the selected one

int param_selected = 0; // which item in the menu is selected

int param_sel_previous; // previous item - used in the menu screen to draw the item before the selected one
int param_sel_next; // next item - used in the menu screen to draw next item after the selected one


// ==== Setup and Loop ==== //

void setup() {
  Serial.begin(115200);
  Serial.println(F("STM32 Transmitter Starting"));
  SPI.begin();
  if (!radio.begin()) {
    Serial.println(F("Radio hardware not responding!"));
    while (1);
  }

  radio.setChannel(90);
  network.begin(this_node);

  pinMode(ARMED_SWITCH, INPUT_PULLUP);
  pinMode(LIGHT_SWITCH, INPUT_PULLUP);

  loadCalibration();

  u8g2.begin();  // start the u8g2 library

  Serial.println(F("STM32 Transmitter Setup Success!"));

  showStartupScreen();
  waitForArmSwitch();
  getBatteryPercentage();

}

void loop() {
  network.update();

  armedSwitchState = !digitalRead(ARMED_SWITCH); // True --> ON, False --> OFF
  lightSwitchState = !digitalRead(LIGHT_SWITCH); // True --> ON, False --> OFF
  // if (calibrateButton.isPressed() && !isCalibrating && !armedSwitchState) {
  //   startCalibration();
  // }




  // if (upButton.isPressed()) {
  //   Serial.println("upButton pressed");
  // }
  // if (downButton.isPressed()) {
  //   Serial.println("downButton pressed");
  // }
  // if (backButton.isPressed()) {
  //   Serial.println("backButton pressed");
  // }

  if (millis() - lastSendTime >= sendInterval) {
    lastSendTime = millis();
    sendPayload();
  }

  // if (isCalibrating) {
  //   handleCalibration();
  // }

  if (millis() - batteryTime >= batteryInterval) {
    batteryTime = millis();
    getBatteryPercentage();
  }

  drawUI();


  if (currentScreen == Screen::HOME) {
    if (menuButton.isPressed()) {
      Serial.println("menuButton pressed");
      if (armedSwitchState) {
        Serial.println("Turn Armed Switch off");
      } else {
        currentScreen = Screen::MENU;
        MenuScreenCal();
      }
    }
  }
  else if (currentScreen == Screen::MENU) {
    if (backButton.isPressed()) {
      currentScreen = Screen::HOME;
      item_selected = 0;
    }
    else if (upButton.isPressed()) {
      item_selected = item_selected - 1;
      if (item_selected < 0) {
        item_selected = NUM_ITEMS-1;
      }
    }
    else if (downButton.isPressed()) {
      item_selected = item_selected + 1;
      if (item_selected >= NUM_ITEMS) {
        item_selected = 0;
      }
    }
    else if (menuButton.isPressed()) {
      Serial.println(menu_items[item_selected]);

      if (strcmp(menu_items[item_selected], "Auto Calibrate") == 0) {
        currentScreen = Screen::AUTOCALIBRATE;
        confirmSelect = false;
      }
      else if (strcmp(menu_items[item_selected], "Manual Setup") == 0) {
        currentScreen = Screen::MANUALSETUP;
        ManualSetupCal();
        loadCalibration();
        convertData(data, params_data_list);
      }
      else if (strcmp(menu_items[item_selected], "Sw and Btn Test") == 0) {
        currentScreen = Screen::SWANDBTNTEST;
      }
    }
    MenuScreenCal();
  }
  else if (currentScreen == Screen::AUTOCALIBRATE) {
    if (backButton.isPressed()) {
      currentScreen = Screen::MENU;
    }
    else if (upButton.isPressed() || downButton.isPressed()) {
      confirmSelect = !confirmSelect;
    }
    else if (menuButton.isPressed()) {
      if (confirmSelect) {
        currentScreen = Screen::AUTOCALIBRATE1;
        prevTime = millis();
        calibrationStage = 0;
      }
      else {
        currentScreen = Screen::MENU;
      }
    }

  }
  else if (currentScreen == Screen::MANUALSETUP) {
    if (!manualEdit) {
      if (backButton.isPressed()) {
        currentScreen = Screen::SAVECHANGES;
        param_selected = 0;
      }
      else if (upButton.isPressed()) {
        param_selected = param_selected - 1;
        if (param_selected < 0) {
          param_selected = NUM_PARAMS-1;
        }
      }
      else if (downButton.isPressed()) {
        param_selected = param_selected + 1;
        if (param_selected >= NUM_PARAMS) {
          param_selected = 0;
        }
      }
      else if (menuButton.isPressed()) {
        Serial.println(param_items[param_selected]);
        manualEdit = true;
      }
    }
    else {
      if (backButton.isPressed()) {
        manualEdit = false;
      }
      else if (upButton.isPressed()) {
        params_data_list[param_selected] += 1;
      }
      else if (downButton.isPressed()) {
        params_data_list[param_selected] -= 1;
      }
      else if (menuButton.isPressed()) {
        manualEdit = false;
      }
    }

    ManualSetupCal();
  }
  else if (currentScreen == Screen::SWANDBTNTEST) {
    if (backButton.isPressed()) {
      currentScreen = Screen::MENU;
    }

  }
  else if (currentScreen == Screen::AUTOCALIBRATE1) {
    handleCalibration();
    if (calibrationStage == 6) {
      currentScreen = Screen::MENU;
    }
  }

  else if (currentScreen == Screen::SAVECHANGES) {
    if (upButton.isPressed() || downButton.isPressed()) {
      saveChangesSelect = !saveChangesSelect;
    }
    else if (menuButton.isPressed()) {
      if (saveChangesSelect) {
        convertBackData(params_data_list);
        saveCalibration();
      }
      currentScreen = Screen::MENU;
    }
  }


}



void showStartupScreen() {
  u8g2.clearBuffer();
  u8g2.setFontMode(1);
  u8g2.setBitmapMode(1);
  u8g2.drawXBMP(11, 0, 106, 64, image_emc_logo2_bits);
  u8g2.sendBuffer();
  delay(2000);
}

void waitForArmSwitch() {
  while (!digitalRead(ARMED_SWITCH)) {
    u8g2.clearBuffer();
    u8g2.setFontMode(1);
    u8g2.setBitmapMode(1);
    u8g2.setFont(u8g2_font_fub11_tr);
    u8g2.drawStr(42, 15, "SWITCH");
    u8g2.drawStr(42, 30, "WARNING");
    u8g2.setFont(u8g2_font_helvR08_tf);
    u8g2.drawStr(12, 53, "Turn arming switch off");
    u8g2.setDrawColor(2);
    u8g2.drawXBMP(4, 6, 30, 23, image_Warning_bits);
    u8g2.sendBuffer();
  }
}

// void startCalibration() {
//   isCalibrating = true;
//   calibrationStage = 0;
// }



void saveCalibration() {
  CalibrationData data = {
    centerX1, centerY1, minOffsetX1, maxOffsetX1, minOffsetY1, maxOffsetY1,
    centerX2, centerY2, minOffsetX2, maxOffsetX2, minOffsetY2, maxOffsetY2
  };
  EEPROM.put(EEPROM_ADDR, data);
  Serial.println("Calibration saved!");
}

void loadCalibration() {

  EEPROM.get(EEPROM_ADDR, data);
  centerX1 = data.centerX1;
  centerY1 = data.centerY1;
  minOffsetX1 = data.minOffsetX1;
  maxOffsetX1 = data.maxOffsetX1;
  minOffsetY1 = data.minOffsetY1;
  maxOffsetY1 = data.maxOffsetY1;
  centerX2 = data.centerX2;
  centerY2 = data.centerY2;
  minOffsetX2 = data.minOffsetX2;
  maxOffsetX2 = data.maxOffsetX2;
  minOffsetY2 = data.minOffsetY2;
  maxOffsetY2 = data.maxOffsetY2;
  Serial.println("Calibration loaded.");
  // Serial.println(centerX1);
  // Serial.println(centerY1);
  // Serial.println(minOffsetX1);
  // Serial.println(maxOffsetX1);
  // Serial.println(minOffsetY1);
  // Serial.println(maxOffsetY1);
  // Serial.println(centerX2);
  // Serial.println(centerY2);
  // Serial.println(minOffsetX2);
  // Serial.println(maxOffsetX2);
  // Serial.println(minOffsetY2);
  // Serial.println(maxOffsetY2);
};

JoystickPayload readJoystick() {
  JoystickPayload p;

  int16_t rawX1 = analogRead(JOYR_X);
  int16_t rawY1 = analogRead(JOYR_Y);
  int16_t offsetX1 = rawX1 - centerX1;
  int16_t offsetY1 = rawY1 - centerY1;

  if (abs(offsetX1) < deadZone) offsetX1 = 0;
  if (abs(offsetY1) < deadZone) offsetY1 = 0;

  if (offsetX1 == 0) {
    p.joyRX = 0;
  } else {
    p.joyRX = map(offsetX1, minOffsetX1, maxOffsetX1, -127, 127);
  }

  if (offsetY1 == 0) {
    p.joyRY = 0;
  } else {
    p.joyRY = map(offsetY1, minOffsetY1, maxOffsetY1, -127, 127);
  }

  int16_t rawX2 = analogRead(JOYL_X);
  int16_t rawY2 = analogRead(JOYL_Y);
  int16_t offsetX2 = rawX2 - centerX2;
  int16_t offsetY2 = rawY2 - centerY2;

  if (abs(offsetX2) < deadZone) offsetX2 = 0;
  if (abs(offsetY2) < deadZone) offsetY2 = 0;

  if (offsetX2 == 0) {
    p.joyLX = 0;
  } else {
    p.joyLX = map(offsetX2, minOffsetX2, maxOffsetX2, -127, 127);
  }

  if (offsetY2 == 0) {
    p.joyLY = 0;
  } else {
    p.joyLY = map(offsetY2, minOffsetY2, maxOffsetY2, -127, 127);
  }

  return p;
}


void sendPayload() {
  // if (isCalibrating) {
    // // payload = {};  // Send 0 during calibration
    // memset(&payload, 0, sizeof(payload));
  // } else {
    // payload = readJoystick();
    // payload.armingSwitch = armedSwitchState;
  // }

  if (currentScreen == Screen::HOME) {
    payload = readJoystick();
    payload.armingSwitch = armedSwitchState;
  }
  else {// Send 0 when not in Home
    memset(&payload, 0, sizeof(payload));
  }

  RF24NetworkHeader header(other_node);
  bool connection = network.write(header, &payload, sizeof(payload));
  // Serial.println(connection);
  if (!connection) {
    notConnectedCount += 1;
  } else {
    notConnectedCount = 0;
  }

  // Serial.print("JR X: "); Serial.print(payload.joyRX);
  // Serial.print(" Y: "); Serial.print(payload.joyRY);
  // Serial.print(" | JL X: "); Serial.print(payload.joyLX);
  // Serial.print(" Y: "); Serial.println(payload.joyLY);
  // Serial.print("ArmingSwitch: "); Serial.println(payload.armingSwitch);
}

void handleCalibration() {
  static int stableCount = 0;
  static int16_t lastX = 0, lastY = 0;
  const int settleThreshold = 5;
  const int stableSamples = 10;

  switch (calibrationStage) {
    case 0:
    {
      if ((millis() - prevTime) > 3000) {
        Serial.println("Center Joystick Right...");
        calibrationStage++;
        stableCount = 0;
      }
      break;
    }
    case 1:
    {
      int16_t currentX = analogRead(JOYR_X);
      int16_t currentY = analogRead(JOYR_Y);
      if (abs(currentX - lastX) < settleThreshold && abs(currentY - lastY) < settleThreshold) {
        stableCount++;
      } else {
        stableCount = 0;
      }
      lastX = currentX;
      lastY = currentY;
      if (stableCount >= stableSamples) {
        centerX1 = lastX;
        centerY1 = lastY;
        minOffsetX1 = maxOffsetX1 = 0;
        minOffsetY1 = maxOffsetY1 = 0;
        calibrationStage++;
        stableCount = 0;
        Serial.println("Joystick Right centered.");
      }
      break;
      
    }
    case 2:
    {
      Serial.println("Center Joystick Left...");
      calibrationStage++;
      stableCount = 0;
      break;
    }

    case 3:
    {
      int16_t currentX = analogRead(JOYL_X);
      int16_t currentY = analogRead(JOYL_Y);
      if (abs(currentX - lastX) < settleThreshold && abs(currentY - lastY) < settleThreshold) {
        stableCount++;
      } else {
        stableCount = 0;
      }
      lastX = currentX;
      lastY = currentY;
      if (stableCount >= stableSamples) {
        centerX2 = lastX;
        centerY2 = lastY;
        minOffsetX2 = maxOffsetX2 = 0;
        minOffsetY2 = maxOffsetY2 = 0;
        calibrationStage++;
        calibrationStartTime = millis();
        Serial.println("Joystick Left centered.");
        Serial.println("Move both joysticks to max ranges...");
      }
      break;
    }

    case 4:
    {
      if (millis() - calibrationStartTime < 5000) {
        int16_t rawX1 = analogRead(JOYR_X) - centerX1;
        int16_t rawY1 = analogRead(JOYR_Y) - centerY1;
        int16_t rawX2 = analogRead(JOYL_X) - centerX2;
        int16_t rawY2 = analogRead(JOYL_Y) - centerY2;

        if (rawX1 < minOffsetX1) minOffsetX1 = rawX1;
        if (rawX1 > maxOffsetX1) maxOffsetX1 = rawX1;
        if (rawY1 < minOffsetY1) minOffsetY1 = rawY1;
        if (rawY1 > maxOffsetY1) maxOffsetY1 = rawY1;

        if (rawX2 < minOffsetX2) minOffsetX2 = rawX2;
        if (rawX2 > maxOffsetX2) maxOffsetX2 = rawX2;
        if (rawY2 < minOffsetY2) minOffsetY2 = rawY2;
        if (rawY2 > maxOffsetY2) maxOffsetY2 = rawY2;
      } else {
        // saveCalibration(); //! TURN THIS BACK ON AFTER TESTING!!!
        // isCalibrating = false;
        Serial.println("Calibration complete!");
        prevTime = millis();
        calibrationStage++;
        
      }
      break;
    }

    case 5: // Show done screen for 3sec
    {
      if ((millis() - prevTime) > 3000) {
        calibrationStage++;
      }
      break;
    }

    case 6:
    {
      break;
    } 

  }
}

void getBatteryPercentage() {
  int adcValue = analogRead(VOLTAGE_PIN);
  float vAdc = (adcValue / (float)adcMax) * vRef;

  // Reverse voltage divider to get actual battery voltage
  float vBattery = vAdc * ((R1 + R2) / R2);
  // Serial.println(vBattery);

  // Map voltage to percentage
  float percent = ((vBattery - batteryMin) / (batteryMax - batteryMin)) * 100.0;
  percent = constrain(percent, 0, 100); // Clamp between 0% and 100%
  batteryPercentage = round(percent); // Round to nearest integer
}

void MenuScreenCal() {
  // set correct values for the previous and next items
  item_sel_previous = item_selected - 1;
  if (item_sel_previous < 0) {item_sel_previous = NUM_ITEMS - 1;} // previous item would be below first = make it the last
  item_sel_next = item_selected + 1;  
  if (item_sel_next >= NUM_ITEMS) {item_sel_next = 0;} // next item would be after last = make it the first
}

void ManualSetupCal() {
  // set correct values for the previous and next items
  param_sel_previous = param_selected - 1;
  if (param_sel_previous < 0) {param_sel_previous = NUM_PARAMS - 1;} // previous item would be below first = make it the last
  param_sel_next = param_selected + 1;  
  if (param_sel_next >= NUM_PARAMS) {param_sel_next = 0;} // next item would be after last = make it the first
}

void drawUI() {
  u8g2.clearBuffer();
  u8g2.setFontMode(1);
  u8g2.setBitmapMode(1);

  if (currentScreen == Screen::HOME) {
    // Wifi
    if (notConnectedCount > 20) {
      u8g2.drawXBMP(2, 1, 15, 16, image_network_not_connected_bits);
    } else {
      u8g2.drawXBMP(2, 1, 15, 16, image_network_bits);
    }

    // Batter Empty Container
    u8g2.drawXBMP(103, 1, 24, 16, image_battery_empty_bits);
    // Power Bar
    u8g2.drawBox(105, 4, round(batteryPercentage/100.0 * 17), 9);
    // Power level
    u8g2.setFont(u8g2_font_t0_13b_tr);
    u8g2.drawStr(80, 14, (String(batteryPercentage)+"%").c_str());

    // Top Divider
    u8g2.drawLine(1, 18, 127, 18);

    // Power bar left
    u8g2.drawBox(7, 31, 8, 28);
    u8g2.setDrawColor(2);
    u8g2.drawBox(8, 32, 6, map(payload.joyLX, -127, 127, 26, 0));

    // Power bar right
    u8g2.drawBox(18, 31, 8, 28);
    u8g2.setDrawColor(2);
    u8g2.drawBox(19, 32, 6, map(payload.joyRX, -127, 127, 26, 0));

    // Power Text
    u8g2.setDrawColor(1);
    u8g2.drawXBMP(4, 23, 24, 5, image_power_text_bits);

    // Right-Speed
    u8g2.setFont(u8g2_font_profont15_tr);
    u8g2.drawStr(37, 55, "R-SPD:");
    itoa(payload.joyRX, joystickBuffer, 10);  //itoa(value, buffer, base - > binary, decimal, hex, etc.)
    u8g2.drawStr(79, 55, joystickBuffer);

    // Left-Speed
    u8g2.drawStr(37, 41, "L-SPD:");
    itoa(payload.joyLX, joystickBuffer, 10);  //itoa(value, buffer, base - > binary, decimal, hex, etc.)
    u8g2.drawStr(79, 41, joystickBuffer);

    // Armed Switch
    if (armedSwitchState) {
      u8g2.drawRFrame(27, 1, 44, 16, 7);

      u8g2.setFont(u8g2_font_t0_13b_tr);
      u8g2.drawStr(31, 14, "Armed");
    }
  }
  else if (currentScreen == Screen::MENU) {
    // selected item background
    u8g2.drawXBMP(0, 22, 128, 21, bitmap_item_sel_outline);

    // draw previous item as icon + label u8g_font_7x14
    u8g2.setFont(u8g2_font_crox1h_tf);
    u8g2.drawStr(25, 15, menu_items[item_sel_previous]); 
    u8g2.drawXBMP( 4, 2, 16, 16, bitmap_icons[item_sel_previous]);          

    // draw selected item as icon + label in bold font
    u8g2.setFont(u8g2_font_crox1hb_tf);    
    u8g2.drawStr(25, 15+20+2, menu_items[item_selected]);   
    u8g2.drawXBMP( 4, 24, 16, 16, bitmap_icons[item_selected]);     

    // draw next item as icon + label
    u8g2.setFont(u8g2_font_crox1h_tf);     
    u8g2.drawStr(25, 15+20+20+2+2, menu_items[item_sel_next]);   
    u8g2.drawXBMP( 4, 46, 16, 16, bitmap_icons[item_sel_next]);  

    // draw scrollbar background
    u8g2.drawXBMP(128-8, 0, 8, 64, bitmap_scrollbar_background);

    // draw scrollbar handle
    u8g2.drawBox(125, 64/NUM_ITEMS * item_selected, 3, 64/NUM_ITEMS); 
  }
  else if (currentScreen == Screen::AUTOCALIBRATE) {

    u8g2.drawRFrame(2, 2, 124, 59, 5);

    u8g2.setFont(u8g2_font_crox1hb_tf);
    u8g2.drawStr(45, 18, "Confirm");

    u8g2.drawStr(21, 33, "Auto Calibrate?");

    if (confirmSelect) {
      u8g2.drawRFrame(68, 40, 30, 15, 5);
    }
    else {
      u8g2.drawRFrame(30, 40, 30, 15, 5);
    }

    u8g2.setFont(u8g2_font_crox1hb_tf);
    u8g2.drawStr(72, 52, "Yes");
    u8g2.drawStr(37, 52, "No");

  }
  else if (currentScreen == Screen::MANUALSETUP) {
    // selected item background
    u8g2.drawXBMP(0, 22, 128, 21, bitmap_item_sel_outline);

    // draw previous item as icon + label u8g_font_7x14
    u8g2.setFont(u8g2_font_crox1h_tf);
    u8g2.drawStr(5, 15, param_items[param_sel_previous]); 
    itoa(params_data_list[param_sel_previous], buf, 10); // base 10
    u8g2.drawStr(90, 15, buf); 

    // u8g2.drawXBMP( 4, 2, 16, 16, bitmap_icons[param_sel_previous]);          

    // draw selected item as icon + label in bold font
    u8g2.setFont(u8g2_font_crox1hb_tf);    
    u8g2.drawStr(5, 15+20+2, param_items[param_selected]);
    // Serial.println(centerX1);
    itoa(params_data_list[param_selected], buf, 10); // base 10
    if (manualEdit) {
      if (millis() - previousMillis >= blinkInterval) {
        previousMillis = millis();
        showText = !showText;
      }
      if (showText) {
        u8g2.drawStr(90, 15+20+2, buf);
      }

    }
    else {
      u8g2.drawStr(90, 15+20+2, buf);   
    }  
    

    // u8g2.drawXBMP( 4, 24, 16, 16, bitmap_icons[item_selected]);     

    // draw next item as icon + label
    u8g2.setFont(u8g2_font_crox1h_tf);     
    u8g2.drawStr(5, 15+20+20+2+2, param_items[param_sel_next]);
    itoa(params_data_list[param_sel_next], buf, 10); // base 10   
    u8g2.drawStr(90, 15+20+20+2+2, buf); 
    // u8g2.drawXBMP( 4, 46, 16, 16, bitmap_icons[item_sel_next]);  

    // draw scrollbar background
    u8g2.drawXBMP(128-8, 0, 8, 64, bitmap_scrollbar_background);

    // draw scrollbar handle
    u8g2.drawBox(125, 64/NUM_PARAMS * param_selected, 3, 64/NUM_PARAMS); 

  }
  else if (currentScreen == Screen::SWANDBTNTEST) {
    
    u8g2.drawRFrame(2, 2, 124, 59, 5);

    u8g2.setFont(u8g2_font_t0_11_tr);
    u8g2.drawStr(13, 21, "Armed:");

    u8g2.drawStr(7, 37, "Lights:");

    u8g2.drawStr(84, 21, "Up:");

    u8g2.drawStr(72, 37, "Down:");

    u8g2.drawStr(19, 53, "Menu:");

    u8g2.drawStr(72, 53, "Back:");

    //Lights
    if (lightSwitchState) {
      u8g2.drawFilledEllipse(58, 32, 6, 6);
    }
    else {
      u8g2.drawEllipse(58, 32, 6, 6);
    }

    //Down
    if (downButton.isPressed()) {
      u8g2.drawFilledEllipse(111, 32, 6, 6);
    }
    else {
      u8g2.drawEllipse(111, 32, 6, 6);
    }

    //Menu
    if (menuButton.isPressed()) {
      u8g2.drawFilledEllipse(58, 48, 6, 6);
    }
    else {
      u8g2.drawEllipse(58, 48, 6, 6);
    }
    
    //Armed
    if (armedSwitchState) {
      u8g2.drawFilledEllipse(58, 16, 6, 6);
    }
    else {
      u8g2.drawEllipse(58, 16, 6, 6);
    }

    //Back
    if (backButton.isPressed()) {
      u8g2.drawFilledEllipse(111, 48, 6, 6);
    }
    else {
      u8g2.drawEllipse(111, 48, 6, 6);
    }

    //Up
    if (upButton.isPressed()) {
      u8g2.drawFilledEllipse(111, 16, 6, 6);
    }
    else {
      u8g2.drawEllipse(111, 16, 6, 6);
    }

  }
  else if (currentScreen == Screen::AUTOCALIBRATE1) {
    u8g2.drawRFrame(2, 2, 124, 59, 5);
    u8g2.setFont(u8g2_font_crox1hb_tf);

    // u8g2.drawStr(45, 18, "Confirm");

    if (calibrationStage <= 3) {
      u8g2.drawStr(44, 29, "Release");
      u8g2.drawStr(38, 45, "Joysticks!");
    }
    else if (calibrationStage == 4) {
      u8g2.drawStr(21, 29, "Move Joysticks");
      u8g2.drawStr(25, 45, "to max range!");
    }
    else if (calibrationStage == 5) {
      u8g2.drawStr(35, 29, "Calibration");
      u8g2.drawStr(38, 45, "Complete!");
    }
  }
  else if (currentScreen == Screen::SAVECHANGES) {

    u8g2.drawRFrame(2, 2, 124, 59, 5);

    u8g2.setFont(u8g2_font_crox1hb_tf);
    // u8g2.drawStr(45, 18, "Confirm");

    u8g2.drawStr(21, 29, "Save Changes?");

    if (saveChangesSelect) {
      u8g2.drawRFrame(68, 40, 30, 15, 5);
    }
    else {
      u8g2.drawRFrame(30, 40, 30, 15, 5);
    }

    u8g2.setFont(u8g2_font_crox1hb_tf);
    u8g2.drawStr(72, 52, "Yes");
    u8g2.drawStr(37, 52, "No");

  }    

    
  
  
  u8g2.sendBuffer();
}


void convertData(const CalibrationData& paramData, int16_t* pList) {
  pList[0] = paramData.centerX1;
  pList[1] = paramData.centerY1;
  pList[2] = paramData.minOffsetX1;
  pList[3] = paramData.maxOffsetX1;
  pList[4] = paramData.minOffsetY1;
  pList[5] = paramData.maxOffsetY1;

  pList[6] = paramData.centerX2;
  pList[7] = paramData.centerY2;
  pList[8] = paramData.minOffsetX2;
  pList[9] = paramData.maxOffsetX2;
  pList[10] = paramData.minOffsetY2;
  pList[11] = paramData.maxOffsetY2;
};

void convertBackData(const int16_t list[12]) {
  centerX1     = list[0];
  centerY1     = list[1];
  minOffsetX1  = list[2];
  maxOffsetX1  = list[3];
  minOffsetY1  = list[4];
  maxOffsetY1  = list[5];

  centerX2     = list[6];
  centerY2     = list[7];
  minOffsetX2  = list[8];
  maxOffsetX2  = list[9];
  minOffsetY2  = list[10];
  maxOffsetY2  = list[11];
}
